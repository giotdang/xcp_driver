/*----------------------------------------------------------------------------
| File: xcp_daq_example.a2l
| Scope:
| Minimal ASAP2 fragment for the DAQ example in xcp_daq_example.c/.h --
| PROTOCOL_LAYER + DAQ (2 events) + XCP_ON_CAN transport, and MEASUREMENT
| records for the fields of app/meas_data.h's single struct instance
| measData: daqHeartbeat / engineRpm / vehicleSpeedKph / coolantTempC
| (scalars), speedPidTelemetry_error/_integral/_output (a struct, split
| into 3 flat records -- XCP has no "whole struct in one DTO" concept,
| see meas_types.h), and torqueSamples (an array, described as ONE
| record with MATRIX_DIM instead of 4 separate ones).
| Deliberately does NOT include calibration parameters (CHARACTERISTIC /
| RECORD_LAYOUT / PAG IF_DATA) -- per CLAUDE.md those are generated
| separately from app/cal_params.h. Merge this fragment's MODULE content
| into that file (or vice versa); an ECU has exactly one MODULE per A2L.
| PLACEHOLDERS TO FIX BEFORE USE:
| - Every ECU_ADDRESS below (0x9000_00xx) is measData's placeholder base
| address (0x90000000) plus each field's offsetof(MeasData_t, field)
| -- struct members additionally add offsetof() into that member's
| own type (e.g. speedPidTelemetry_integral = base + offsetof(...,
| speedPidTelemetry) + offsetof(PidTelemetry_t, integral)). All of
| this matches MEAS_PARAMS_TABLE order in meas_params.h with natural
| alignment. After building, run tools/sync_a2l_addresses.py to
| replace 0x90000000 with measData's real link-time address and
| recompute every ECU_ADDRESS below -- only measData needs to be
| looked up in the .map/.elf, not each field/member individually.
| - ASAP2_VERSION and the XCP protocol/transport IF_DATA field order can
| be tool/version-sensitive; if CANape's A2L parser rejects a field,
| check its ASAP2 / ASAM XCP addendum version against this file's.
| Matches xcp_cfg.h / xcp_tricore.h at time of writing:
| kXcpMaxCTO=8, kXcpMaxDTO=8, XCP_CPUTYPE_LITTLEENDIAN,
| XCP_CAN_RX_ID=0x7E0 (master->slave), XCP_CAN_TX_ID=0x7E1 (slave->master),
| baudrate 500 kbps, standard 11-bit CAN ID.
| kXcpMaxEvent is NOT defined -> GET_DAQ_EVENT_INFO is unsupported, so
| OPTIONAL_CMD GET_DAQ_EVENT_INFO is intentionally absent below; CANape
| must read event 0/1's name and cycle time from this static A2L instead
| of discovering them live over XCP.
----------------------------------------------------------------------------*/ ASAP2_VERSION 1 71
/begin PROJECT XCP_DAQ_EXAMPLE ""
/begin MODULE AURIX_XCP ""
/begin MOD_COMMON "" BYTE_ORDER MSB_LAST /* little-endian TriCore */ ALIGNMENT_BYTE 1 ALIGNMENT_WORD 2 ALIGNMENT_LONG 4 ALIGNMENT_FLOAT32_IEEE 4 ALIGNMENT_FLOAT64_IEEE 8 /end MOD_COMMON
/begin IF_DATA XCP
 /begin PROTOCOL_LAYER 0x0100 /* XCP protocol layer version 1.0 */ 1000 /* T1 [ms] */ 2000 /* T2 [ms] */ 0 /* T3 [ms] */ 0 /* T4 [ms] */ 0 /* T5 [ms] */ 0 /* T6 [ms] */ 0 /* T7 [ms] */ 8 /* MAX_CTO = kXcpMaxCTO */ 8 /* MAX_DTO = kXcpMaxDTO */ BYTE_ORDER_MSB_LAST ADDRESS_GRANULARITY_BYTE OPTIONAL_CMD GET_COMM_MODE_INFO /* XCP_ENABLE_COMM_MODE_INFO */ OPTIONAL_CMD GET_DAQ_PROCESSOR_INFO /* XCP_ENABLE_DAQ_PROCESSOR_INFO */ OPTIONAL_CMD GET_DAQ_RESOLUTION_INFO /* XCP_ENABLE_DAQ_RESOLUTION_INFO */ OPTIONAL_CMD SET_DAQ_PTR OPTIONAL_CMD WRITE_DAQ OPTIONAL_CMD GET_DAQ_LIST_MODE OPTIONAL_CMD SET_DAQ_LIST_MODE OPTIONAL_CMD START_STOP_SYNCH OPTIONAL_CMD START_STOP_DAQ_LIST OPTIONAL_CMD GET_CAL_PAGE /* XCP_ENABLE_CALIBRATION_PAGE */ OPTIONAL_CMD SET_CAL_PAGE OPTIONAL_CMD COPY_CAL_PAGE /* XCP_ENABLE_PAGE_COPY */ /end PROTOCOL_LAYER
 /begin DAQ DYNAMIC 0x02 /* MAX_DAQ -- 2 DAQ lists in this example */ 0x02 /* MAX_EVENT_CHANNEL -- 2 events */ 0x00 /* MIN_DAQ -- no predefined/fixed lists */ OPTIMISATION_TYPE_DEFAULT ADDRESS_EXTENSION_FREE IDENTIFICATION_FIELD_TYPE_ABSOLUTE /* PID-only ODT header (no ODT,DAQ header) */ GRANULARITY_ODT_ENTRY_SIZE_DAQ_BYTE 0x07 /* MAX_ODT_ENTRY_SIZE_DAQ = kXcpMaxDTO - 1 (PID byte) */ OVERLOAD_INDICATION_PID /* XCP_ENABLE_DAQ_OVERRUN_INDICATION, bit7 of PID */
  /begin EVENT
   /begin EVENT "10 ms raster" "10ms" 0x00 /* EVENT_CHANNEL_NUMBER = XCP_EVENT_10MS */ DAQ 0x01 /* MAX_DAQ_LIST (lists usable on this event) */ 10 /* EVENT_CHANNEL_TIME_CYCLE */ 6 /* EVENT_CHANNEL_TIME_UNIT: 6 = 1 ms -> 10 * 1ms = 10ms */ 0 /* EVENT_CHANNEL_PRIORITY */ /end EVENT
   /begin EVENT "100 ms raster" "100ms" 0x01 /* EVENT_CHANNEL_NUMBER = XCP_EVENT_100MS */ DAQ 0x01 100 /* EVENT_CHANNEL_TIME_CYCLE */ 6 /* EVENT_CHANNEL_TIME_UNIT: 6 = 1 ms -> 100 * 1ms = 100ms */ 0 /* EVENT_CHANNEL_PRIORITY */ /end EVENT
  /end EVENT
 /end DAQ
 /begin XCP_ON_CAN 0x0100 /* XCP on CAN transport-layer version 1.0 */ CAN_ID_BROADCAST 0x7E0 CAN_ID_MASTER 0x7E0 /* host -> ECU (= XCP_CAN_RX_ID) */ CAN_ID_SLAVE 0x7E1 /* ECU -> host (= XCP_CAN_TX_ID) */ BAUDRATE 500000 SAMPLE_POINT 75 SAMPLE_1 1 SAMPLE_2 1 BTL_CYCLES 10 SJW 2 SYNC_EDGE SINGLE MAX_DLC_REQUIRED /end XCP_ON_CAN
/end IF_DATA
/begin MEASUREMENT daqHeartbeat "Free-running DAQ heartbeat, increments every 10 ms -- sanity check signal" ULONG NO_COMPU_METHOD 0 /* RESOLUTION */ 0 /* ACCURACY */ 0 4294967295 ECU_ADDRESS 0x90000000 /* PLACEHOLDER = measData + offsetof(..,daqHeartbeat)=0x0 */
 /begin IF_DATA XCP
  /begin DAQ_EVENT FIXED_EVENT_LIST EVENT 0x00 /end DAQ_EVENT
 /end IF_DATA
/end MEASUREMENT
/begin MEASUREMENT engineRpm "Simulated engine speed, 10 ms raster" UWORD NO_COMPU_METHOD 0 0 0 8000 ECU_ADDRESS 0x90000004 /* PLACEHOLDER = measData + offsetof(..,engineRpm)=0x4 */ FORMAT "%4.0"
 /begin IF_DATA XCP
  /begin DAQ_EVENT FIXED_EVENT_LIST EVENT 0x00 /end DAQ_EVENT
 /end IF_DATA
/end MEASUREMENT
/begin MEASUREMENT vehicleSpeedKph "Simulated vehicle speed, 10 ms raster" FLOAT32_IEEE NO_COMPU_METHOD 0 0 0.0 250.0 ECU_ADDRESS 0x90000008 /* PLACEHOLDER = measData + offsetof(..,vehicleSpeedKph)=0x8 (2 bytes padding after engineRpm) */ FORMAT "%5.1"
 /begin IF_DATA XCP
  /begin DAQ_EVENT FIXED_EVENT_LIST EVENT 0x00 /end DAQ_EVENT
 /end IF_DATA
/end MEASUREMENT
/begin MEASUREMENT coolantTempC "Simulated coolant temperature, 100 ms raster" FLOAT32_IEEE NO_COMPU_METHOD 0 0 -40.0 150.0 ECU_ADDRESS 0x9000000C /* PLACEHOLDER = measData + offsetof(..,coolantTempC)=0xC */ FORMAT "%5.1"
 /begin IF_DATA XCP
  /begin DAQ_EVENT FIXED_EVENT_LIST EVENT 0x01 /* bound to "100 ms raster" */ /end DAQ_EVENT
 /end IF_DATA
/end MEASUREMENT
/* ============================================================
* Struct scenario: PidTelemetry_t (meas_types.h) is 12 bytes --
* bigger than XCP_MAX_ODT_ENTRY_SIZE (7) -- so it is measured as 3
* flat records instead of 1. Each ECU_ADDRESS is measData's base +
* offsetof(MeasData_t, speedPidTelemetry) [0x10] + the member's own
* offsetof(PidTelemetry_t, member).
* ============================================================ */
/begin MEASUREMENT speedPidTelemetry_error "PID loop error this cycle (struct member 1/3, see meas_types.h)" FLOAT32_IEEE NO_COMPU_METHOD 0 0 -250.0 250.0 ECU_ADDRESS 0x90000010 /* PLACEHOLDER = measData + 0x10 + offsetof(PidTelemetry_t,error)=0x0 */ FORMAT "%6.2"
 /begin IF_DATA XCP
  /begin DAQ_EVENT FIXED_EVENT_LIST EVENT 0x00 /end DAQ_EVENT
 /end IF_DATA
/end MEASUREMENT
/begin MEASUREMENT speedPidTelemetry_integral "PID loop accumulated integral term (struct member 2/3)" FLOAT32_IEEE NO_COMPU_METHOD 0 0 -100.0 /* LOWER_LIMIT (matches speedPid.outMin default) */ 100.0 /* UPPER_LIMIT (matches speedPid.outMax default) */ ECU_ADDRESS 0x90000014 /* PLACEHOLDER = measData + 0x10 + offsetof(PidTelemetry_t,integral)=0x4 */ FORMAT "%6.2"
 /begin IF_DATA XCP
  /begin DAQ_EVENT FIXED_EVENT_LIST EVENT 0x00 /end DAQ_EVENT
 /end IF_DATA
/end MEASUREMENT
/begin MEASUREMENT speedPidTelemetry_output "PID loop output, clamped to speedPid.outMin/outMax (struct member 3/3)" FLOAT32_IEEE NO_COMPU_METHOD 0 0 -100.0 100.0 ECU_ADDRESS 0x90000018 /* PLACEHOLDER = measData + 0x10 + offsetof(PidTelemetry_t,output)=0x8 */ FORMAT "%6.2"
 /begin IF_DATA XCP
  /begin DAQ_EVENT FIXED_EVENT_LIST EVENT 0x00 /end DAQ_EVENT
 /end IF_DATA
/end MEASUREMENT
/* ============================================================
* Array scenario: torqueSamples[4] (float32) described as ONE
* MEASUREMENT with MATRIX_DIM -- CANape shows/records it as a
* single array signal, but still needs 4 separate ODT entries on
* the wire (one float32 per entry: 2 elements = 8 bytes > the
* 7-byte PID-only ODT budget, so no two elements can share an
* entry here). MATRIX_DIM saves A2L authoring effort, not CAN
* frames -- see the ODT budget note in xcp_daq_example.c.
* ============================================================ */
/begin MEASUREMENT torqueSamples "Last 4 torqueMap samples (CAL array -> MEAS array history), 10 ms raster" FLOAT32_IEEE NO_COMPU_METHOD 0 0 0.0 100.0 ECU_ADDRESS 0x9000001C /* PLACEHOLDER = measData + offsetof(..,torqueSamples)=0x1C */ FORMAT "%5.1" MATRIX_DIM 4
 /begin IF_DATA XCP
  /begin DAQ_EVENT FIXED_EVENT_LIST EVENT 0x00 /end DAQ_EVENT
 /end IF_DATA
/end MEASUREMENT
/end MODULE
/end PROJECT
