/*----------------------------------------------------------------------------
| File: xcp_daq_example.a2l
| Scope:
| Minimal ASAP2 fragment for the DAQ example in xcp_daq_example.c/.h --
| PROTOCOL_LAYER + DAQ (2 events) + XCP_ON_CAN transport, and the 4
| MEASUREMENT records for g_xcpEngineRpm / g_xcpVehicleSpeedKph /
| g_xcpCoolantTempC / g_xcpDaqHeartbeat.
| Deliberately does NOT include calibration parameters (CHARACTERISTIC /
| RECORD_LAYOUT / PAG IF_DATA) -- per CLAUDE.md those are generated
| separately from app/cal_params.h. Merge this fragment's MODULE content
| into that file (or vice versa); an ECU has exactly one MODULE per A2L.
| PLACEHOLDERS TO FIX BEFORE USE:
| - Every ECU_ADDRESS below (0x9000_00xx) is a stand-in. After building,
| look up the real link-time address of each global symbol in the
| linker .map file and replace it -- ECU_ADDRESS must match exactly
| or CANape will read garbage / fault.
| - ASAP2_VERSION and the XCP protocol/transport IF_DATA field order can
| be tool/version-sensitive; if CANape's A2L parser rejects a field,
| check its ASAP2 / ASAM XCP addendum version against this file's.
| Matches xcp_cfg.h / xcp_tricore.h at time of writing:
| kXcpMaxCTO=8, kXcpMaxDTO=8, XCP_CPUTYPE_LITTLEENDIAN,
| XCP_CAN_RX_ID=0x7E0 (master->slave), XCP_CAN_TX_ID=0x7E1 (slave->master),
| baudrate 500 kbps, standard 11-bit CAN ID.
| kXcpMaxEvent is NOT defined -> GET_DAQ_EVENT_INFO is unsupported, so
| OPTIONAL_CMD GET_DAQ_EVENT_INFO is intentionally absent below; CANape
| must read event 0/1's name and cycle time from this static A2L instead
| of discovering them live over XCP.
----------------------------------------------------------------------------*/ ASAP2_VERSION 1 71
/begin PROJECT XCP_DAQ_EXAMPLE ""
/begin MODULE AURIX_XCP ""
/begin MOD_COMMON "" BYTE_ORDER MSB_LAST /* little-endian TriCore */ ALIGNMENT_BYTE 1 ALIGNMENT_WORD 2 ALIGNMENT_LONG 4 ALIGNMENT_FLOAT32_IEEE 4 ALIGNMENT_FLOAT64_IEEE 8 /end MOD_COMMON
/begin IF_DATA XCP
 /begin PROTOCOL_LAYER 0x0100 /* XCP protocol layer version 1.0 */ 1000 /* T1 [ms] */ 2000 /* T2 [ms] */ 0 /* T3 [ms] */ 0 /* T4 [ms] */ 0 /* T5 [ms] */ 0 /* T6 [ms] */ 0 /* T7 [ms] */ 8 /* MAX_CTO = kXcpMaxCTO */ 8 /* MAX_DTO = kXcpMaxDTO */ BYTE_ORDER_MSB_LAST ADDRESS_GRANULARITY_BYTE OPTIONAL_CMD GET_COMM_MODE_INFO /* XCP_ENABLE_COMM_MODE_INFO */ OPTIONAL_CMD GET_DAQ_PROCESSOR_INFO /* XCP_ENABLE_DAQ_PROCESSOR_INFO */ OPTIONAL_CMD GET_DAQ_RESOLUTION_INFO /* XCP_ENABLE_DAQ_RESOLUTION_INFO */ OPTIONAL_CMD SET_DAQ_PTR OPTIONAL_CMD WRITE_DAQ OPTIONAL_CMD GET_DAQ_LIST_MODE OPTIONAL_CMD SET_DAQ_LIST_MODE OPTIONAL_CMD START_STOP_SYNCH OPTIONAL_CMD START_STOP_DAQ_LIST OPTIONAL_CMD GET_CAL_PAGE /* XCP_ENABLE_CALIBRATION_PAGE */ OPTIONAL_CMD SET_CAL_PAGE OPTIONAL_CMD COPY_CAL_PAGE /* XCP_ENABLE_PAGE_COPY */ /end PROTOCOL_LAYER
 /begin DAQ DYNAMIC 0x02 /* MAX_DAQ -- 2 DAQ lists in this example */ 0x02 /* MAX_EVENT_CHANNEL -- 2 events */ 0x00 /* MIN_DAQ -- no predefined/fixed lists */ OPTIMISATION_TYPE_DEFAULT ADDRESS_EXTENSION_FREE IDENTIFICATION_FIELD_TYPE_ABSOLUTE /* PID-only ODT header (no ODT,DAQ header) */ GRANULARITY_ODT_ENTRY_SIZE_DAQ_BYTE 0x07 /* MAX_ODT_ENTRY_SIZE_DAQ = kXcpMaxDTO - 1 (PID byte) */ OVERLOAD_INDICATION_PID /* XCP_ENABLE_DAQ_OVERRUN_INDICATION, bit7 of PID */
  /begin EVENT
   /begin EVENT "10 ms raster" "10ms" 0x00 /* EVENT_CHANNEL_NUMBER = XCP_EVENT_10MS */ DAQ 0x01 /* MAX_DAQ_LIST (lists usable on this event) */ 10 /* EVENT_CHANNEL_TIME_CYCLE */ 6 /* EVENT_CHANNEL_TIME_UNIT: 6 = 1 ms -> 10 * 1ms = 10ms */ 0 /* EVENT_CHANNEL_PRIORITY */ /end EVENT
   /begin EVENT "100 ms raster" "100ms" 0x01 /* EVENT_CHANNEL_NUMBER = XCP_EVENT_100MS */ DAQ 0x01 100 /* EVENT_CHANNEL_TIME_CYCLE */ 6 /* EVENT_CHANNEL_TIME_UNIT: 6 = 1 ms -> 100 * 1ms = 100ms */ 0 /* EVENT_CHANNEL_PRIORITY */ /end EVENT
  /end EVENT
 /end DAQ
 /begin XCP_ON_CAN 0x0100 /* XCP on CAN transport-layer version 1.0 */ CAN_ID_BROADCAST 0x7E0 CAN_ID_MASTER 0x7E0 /* host -> ECU (= XCP_CAN_RX_ID) */ CAN_ID_SLAVE 0x7E1 /* ECU -> host (= XCP_CAN_TX_ID) */ BAUDRATE 500000 SAMPLE_POINT 75 SAMPLE_1 1 SAMPLE_2 1 BTL_CYCLES 10 SJW 2 SYNC_EDGE SINGLE MAX_DLC_REQUIRED /end XCP_ON_CAN
/end IF_DATA
/begin MEASUREMENT g_xcpDaqHeartbeat "Free-running DAQ heartbeat, increments every 10 ms -- sanity check signal" ULONG NO_COMPU_METHOD 0 /* RESOLUTION */ 0 /* ACCURACY */ 0 4294967295 ECU_ADDRESS 0x90000000
 /begin IF_DATA XCP
  /begin DAQ_EVENT FIXED_EVENT_LIST EVENT 0x00 /end DAQ_EVENT
 /end IF_DATA
/end MEASUREMENT
/begin MEASUREMENT g_xcpEngineRpm "Simulated engine speed, 10 ms raster" UWORD NO_COMPU_METHOD 0 0 0 8000 ECU_ADDRESS 0x90000004 FORMAT "%4.0"
 /begin IF_DATA XCP
  /begin DAQ_EVENT FIXED_EVENT_LIST EVENT 0x00 /end DAQ_EVENT
 /end IF_DATA
/end MEASUREMENT
/begin MEASUREMENT g_xcpVehicleSpeedKph "Simulated vehicle speed, 10 ms raster" FLOAT32_IEEE NO_COMPU_METHOD 0 0 0.0 250.0 ECU_ADDRESS 0x90000008 FORMAT "%5.1"
 /begin IF_DATA XCP
  /begin DAQ_EVENT FIXED_EVENT_LIST EVENT 0x00 /end DAQ_EVENT
 /end IF_DATA
/end MEASUREMENT
/begin MEASUREMENT g_xcpCoolantTempC "Simulated coolant temperature, 100 ms raster" FLOAT32_IEEE NO_COMPU_METHOD 0 0 -40.0 150.0 ECU_ADDRESS 0x9000000C FORMAT "%5.1"
 /begin IF_DATA XCP
  /begin DAQ_EVENT FIXED_EVENT_LIST EVENT 0x01 /* bound to "100 ms raster" */ /end DAQ_EVENT
 /end IF_DATA
/end MEASUREMENT
/end MODULE
/end PROJECT
